## build/conf/bblayers.conf
```bitbake
# POKY_BBLAYERS_CONF_VERSION is increased each time build/conf/bblayers.conf
# changes incompatibly
POKY_BBLAYERS_CONF_VERSION = "2"

BBPATH = "${TOPDIR}"
BBFILES ?= ""

BBLAYERS ?= " \
  ${HOME}/yoctoproject/poky/meta \
  ${HOME}/yoctoproject/poky/meta-poky \
  ${HOME}/yoctoproject/meta-openembedded/meta-oe \
  ${HOME}/yoctoproject/meta-openembedded/meta-multimedia \
  ${HOME}/yoctoproject/meta-openembedded/meta-networking \
  ${HOME}/yoctoproject/meta-openembedded/meta-python \
  ${HOME}/yoctoproject/meta-raspberrypi \
  ${HOME}/yoctoproject/meta-qt5 \
  ${HOME}/yoctoproject/meta-mylayer \
  "
```
